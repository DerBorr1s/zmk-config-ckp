## config/boards/arm/bt65/Kconfig
```kconfig
# SPDX-License-Identifier: MIT

config BOARD_ENABLE_DCDC
	bool "Enable DCDC mode"
	select SOC_DCDC_NRF52X
	default y
	depends on BOARD_BT65

config ZMK_BACKLIGHT_AUTO_OFF_IDLE
	bool "Turn off backlight when keyboard goes into idle state"
	default y
	
config ZMK_RGB_UNDERGLOW_AUTO_OFF_IDLE
	bool "Turn off RGB underglow when keyboard goes into idle state"
	default y
	
config ZMK_IDLE_TIMEOUT
	int "Milliseconds of inactivity before entering idle state (OLED shutoff, etc)"
	default 300000
	
config ZMK_SLEEP
	bool "Enable deep sleep support"
	default y
	
config ZMK_IDLE_SLEEP_TIMEOUT
	int "Milliseconds of inactivity before entering deep sleep"
	default 600000
	
config ZMK_EXT_POWER
	bool "Enable support to control external power output"
	default y
```

## config/boards/arm/bt65/Kconfig.defconfig
```kconfig
# Copyright (c) 2021 Polarity Works
# SPDX-License-Identifier: MIT

if BOARD_BT65

config BOARD
	default "bt65"

if USB

config USB_NRFX
	default y

config USB_DEVICE_STACK
	default y

endif # USB

config BT_CTLR
	default BT

config ZMK_BLE
	default y

CONFIG_ZMK_BLE_INIT_PRIORITY=5

config ZMK_USB
	default n

config ZMK_BATTERY_VOLTAGE_DIVIDER
	default y

config ZMK_KEYBOARD_NAME
	default "Jans_BT65"

endif # BOARD_BT65
```
